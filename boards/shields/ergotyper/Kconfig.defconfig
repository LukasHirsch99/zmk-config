## boards/shields/ergotyper/Kconfig.defconfig
```kconfig
if SHIELD_ERGOTYPER_LEFT

config ZMK_KEYBOARD_NAME
	default "Ergotyper"

config ZMK_SPLIT_ROLE_CENTRAL
	default y

endif

if SHIELD_ERGOTYPER_LEFT || SHIELD_ERGOTYPER_RIGHT

config ZMK_SPLIT
    default y

endif
```

## boards/shields/ergotyper/Kconfig.shield
```kconfig
config SHIELD_ERGOTYPER_LEFT
	def_bool $(shields_list_contains,ergotyper_left)

config SHIELD_ERGOTYPER_RIGHT
	def_bool $(shields_list_contains,ergotyper_right)
```

## config/boards/shields/ergotyper/Kconfig.defconfig
```kconfig
if SHIELD_ERGOTYPER_LEFT

config ZMK_KEYBOARD_NAME
	default "Ergotyper"

config ZMK_SPLIT_ROLE_CENTRAL
	default y

endif

if SHIELD_ERGOTYPER_LEFT || SHIELD_ERGOTYPER_RIGHT

config ZMK_SPLIT
    default y

config ZMK_SLEEP
    default y

config ZMK_IDLE_SLEEP_TIMEOUT
    default 300000

endif
```
